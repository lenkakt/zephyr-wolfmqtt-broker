## CMakeLists.txt
```
# SPDX-License-Identifier: GPL-3.0-or-later
cmake_minimum_required(VERSION 3.20.0)

# A manual copy, for workspaces where west doesn't provide wolfMQTT
if(EXISTS ${CMAKE_CURRENT_LIST_DIR}/deps/wolfmqtt)
  list(APPEND ZEPHYR_EXTRA_MODULES ${CMAKE_CURRENT_LIST_DIR}/deps/wolfmqtt)
endif()

if(EXISTS ${CMAKE_CURRENT_LIST_DIR}/wifi.local.conf AND NOT BOARD MATCHES "^native_sim")
  list(APPEND EXTRA_CONF_FILE ${CMAKE_CURRENT_LIST_DIR}/wifi.local.conf)
endif()

find_package(Zephyr REQUIRED HINTS $ENV{ZEPHYR_BASE})
project(wolfmqtt_broker)

target_sources(app PRIVATE src/main.c src/broker_net.c)
target_sources_ifdef(CONFIG_WIFI app PRIVATE src/wifi.c)
target_sources_ifdef(CONFIG_APP_MEM_REPORT app PRIVATE src/mem_report.c)
target_include_directories(app PRIVATE src)
zephyr_compile_definitions(WOLFMQTT_USER_SETTINGS)
```

## Kconfig
```
# SPDX-License-Identifier: GPL-3.0-or-later
source "Kconfig.zephyr"

config APP_WIFI_SSID
	string "Wi-Fi network name"
	depends on WIFI

config APP_WIFI_PSK
	string "Wi-Fi password"
	depends on WIFI

config APP_MEM_REPORT
	bool "Print heap and stack use every 10 seconds"
	depends on SYS_HEAP_RUNTIME_STATS && THREAD_ANALYZER
```

## west.yml
```
# SPDX-License-Identifier: GPL-3.0-or-later
manifest:
  self:
    path: zephyr-wolfmqtt-broker

  remotes:
    - name: zephyrproject-rtos
      url-base: https://github.com/zephyrproject-rtos
    - name: wolfssl
      url-base: https://github.com/wolfSSL

  projects:
    - name: zephyr
      remote: zephyrproject-rtos
      revision: v4.4.2
      import:
        name-allowlist:
          - hal_espressif
          - mbedtls
          - picolibc
    - name: wolfMQTT
      remote: wolfssl
      revision: v2.2.0
      path: modules/lib/wolfmqtt
```

## prj.conf
```kconfig
CONFIG_WOLFMQTT=y
CONFIG_WOLFMQTT_SETTINGS_FILE="user_settings.h"

CONFIG_NETWORKING=y
CONFIG_NET_SOCKETS=y
CONFIG_NET_TCP=y
CONFIG_NET_IPV4=y
CONFIG_NET_IPV6=n
CONFIG_ZVFS_POLL_MAX=16
CONFIG_ZVFS_OPEN_MAX=20

CONFIG_MAIN_STACK_SIZE=4096
CONFIG_LOG=y
CONFIG_PRINTK=y
```

## mem_report.conf
```kconfig
# Memory report, add with -DEXTRA_CONF_FILE=mem_report.conf
CONFIG_APP_MEM_REPORT=y
CONFIG_SYS_HEAP_RUNTIME_STATS=y
CONFIG_THREAD_ANALYZER=y
CONFIG_THREAD_ANALYZER_USE_PRINTK=y
CONFIG_THREAD_NAME=y
CONFIG_INIT_STACKS=y
# printk straight to the console, so the report isn't dropped
CONFIG_LOG_PRINTK=n
```

## boards/native_sim_native_64.conf
```kconfig
# Sockets go straight to the Linux host, so no TAP setup is needed
CONFIG_NET_DRIVERS=y
CONFIG_NET_SOCKETS_OFFLOAD=y
CONFIG_NET_NATIVE_OFFLOADED_SOCKETS=y
CONFIG_ETH_NATIVE_TAP=n
```

## boards/xiao_esp32c6_esp32c6_hpcore.conf
```kconfig
CONFIG_WIFI=y
CONFIG_NET_L2_WIFI_MGMT=y
CONFIG_NET_DHCPV4=y
CONFIG_NET_MGMT=y
CONFIG_ESP32_WIFI_STA_RECONNECT=y

# 10 clients, the listener and a spare
CONFIG_NET_MAX_CONTEXTS=14
CONFIG_NET_MAX_CONN=14
CONFIG_NET_PKT_RX_COUNT=16
CONFIG_NET_PKT_TX_COUNT=16
CONFIG_NET_BUF_RX_COUNT=32
CONFIG_NET_BUF_TX_COUNT=32

# 1 KB was 90% used on the Fire
CONFIG_LOG_PROCESS_THREAD_STACK_SIZE=2048
```

## src/main.c
```c
/* SPDX-License-Identifier: GPL-3.0-or-later */
#include <zephyr/kernel.h>
#include <zephyr/sys/printk.h>

#include "broker_net.h"
#include "wifi.h"

static MqttBroker broker;
static MqttBrokerNet net;

int main(void)
{
	int rc;

	printk("MqttBroker uses %zu bytes of RAM\n", sizeof(broker));

#ifdef CONFIG_WIFI
	rc = wifi_connect();
	if (rc != 0) {
		return rc;
	}
#endif

	broker_net_init(&net);

	rc = MqttBroker_Init(&broker, &net);
	if (rc != MQTT_CODE_SUCCESS) {
		printk("init failed: %d\n", rc);
		return rc;
	}

	rc = MqttBroker_Run(&broker);
	printk("broker stopped: %d\n", rc);
	return rc;
}
```

## src/broker_net.c
```c
/* SPDX-License-Identifier: GPL-3.0-or-later */
#include <errno.h>
#include <string.h>
#include <zephyr/net/socket.h>

#include "broker_net.h"

static int net_listen(void *ctx, BROKER_SOCKET_T *sock, word16 port, int backlog)
{
	struct net_sockaddr_in addr = {0};
	int opt = 1;
	int fd = zsock_socket(NET_AF_INET, NET_SOCK_STREAM, NET_IPPROTO_TCP);

	ARG_UNUSED(ctx);

	if (fd < 0) {
		return MQTT_CODE_ERROR_NETWORK;
	}

	zsock_setsockopt(fd, ZSOCK_SOL_SOCKET, ZSOCK_SO_REUSEADDR, &opt, sizeof(opt));

	addr.sin_family = NET_AF_INET;
	addr.sin_port = net_htons(port);

	if (zsock_bind(fd, (struct net_sockaddr *)&addr, sizeof(addr)) < 0 ||
	    zsock_listen(fd, backlog) < 0) {
		zsock_close(fd);
		return MQTT_CODE_ERROR_NETWORK;
	}

	*sock = fd;
	return MQTT_CODE_SUCCESS;
}

static int wait_for(int fd, short events, int timeout_ms)
{
	struct zsock_pollfd pfd = {.fd = fd, .events = events};
	int rc = zsock_poll(&pfd, 1, timeout_ms);

	if (rc == 0) {
		return MQTT_CODE_ERROR_TIMEOUT;
	}
	return rc < 0 ? MQTT_CODE_ERROR_NETWORK : MQTT_CODE_SUCCESS;
}

static int net_accept(void *ctx, BROKER_SOCKET_T listen_sock, BROKER_SOCKET_T *client_sock)
{
	int fd;

	ARG_UNUSED(ctx);

	/* Host sockets on native_sim never report ready with a zero timeout */
	if (wait_for(listen_sock, ZSOCK_POLLIN, 5) != MQTT_CODE_SUCCESS) {
		return MQTT_CODE_CONTINUE;
	}

	fd = zsock_accept(listen_sock, NULL, NULL);
	if (fd < 0) {
		return MQTT_CODE_ERROR_NETWORK;
	}

	*client_sock = fd;
	return MQTT_CODE_SUCCESS;
}

static int transfer_result(int rc)
{
	if (rc > 0) {
		return rc;
	}
	if (rc < 0 && (errno == EAGAIN || errno == EWOULDBLOCK)) {
		return MQTT_CODE_CONTINUE;
	}
	return MQTT_CODE_ERROR_NETWORK;
}

static int net_read(void *ctx, BROKER_SOCKET_T sock, byte *buf, int buf_len, int timeout_ms)
{
	int rc;

	ARG_UNUSED(ctx);

	if (buf == NULL || buf_len <= 0) {
		return MQTT_CODE_ERROR_BAD_ARG;
	}
	if (timeout_ms > 0) {
		rc = wait_for(sock, ZSOCK_POLLIN, timeout_ms);
		if (rc != MQTT_CODE_SUCCESS) {
			return rc;
		}
	}
	return transfer_result(zsock_recv(sock, buf, buf_len, ZSOCK_MSG_DONTWAIT));
}

static int net_write(void *ctx, BROKER_SOCKET_T sock, const byte *buf, int buf_len, int timeout_ms)
{
	int rc;

	ARG_UNUSED(ctx);

	if (buf == NULL || buf_len <= 0) {
		return MQTT_CODE_ERROR_BAD_ARG;
	}
	if (timeout_ms > 0) {
		rc = wait_for(sock, ZSOCK_POLLOUT, timeout_ms);
		if (rc != MQTT_CODE_SUCCESS) {
			return rc;
		}
	}
	return transfer_result(zsock_send(sock, buf, buf_len, ZSOCK_MSG_DONTWAIT));
}

static int net_close(void *ctx, BROKER_SOCKET_T sock)
{
	ARG_UNUSED(ctx);

	if (sock != BROKER_SOCKET_INVALID) {
		zsock_close(sock);
	}
	return MQTT_CODE_SUCCESS;
}

void broker_net_init(MqttBrokerNet *net)
{
	memset(net, 0, sizeof(*net));
	net->listen = net_listen;
	net->accept = net_accept;
	net->read = net_read;
	net->write = net_write;
	net->close = net_close;
}
```

## src/broker_net.h
```c
/* SPDX-License-Identifier: GPL-3.0-or-later */
#ifndef BROKER_NET_H
#define BROKER_NET_H

#include "wolfmqtt/mqtt_broker.h"

void broker_net_init(MqttBrokerNet *net);

#endif
```

## src/mem_report.c
```c
/* SPDX-License-Identifier: GPL-3.0-or-later */
#include <zephyr/kernel.h>
#include <zephyr/sys/printk.h>
#include <zephyr/sys/sys_heap.h>
#include <zephyr/debug/thread_analyzer.h>

/* Wi-Fi allocates from the system heap */
extern struct k_heap _system_heap;

static void mem_report(void)
{
	struct sys_memory_stats s;

	while (1) {
		k_sleep(K_SECONDS(10));
		sys_heap_runtime_stats_get(&_system_heap.heap, &s);
		printk("heap: used %zu, peak %zu, free %zu\n",
		       s.allocated_bytes, s.max_allocated_bytes, s.free_bytes);
		thread_analyzer_print(0);
	}
}

K_THREAD_DEFINE(mem_report_id, 2048, mem_report, NULL, NULL, NULL, 14, 0, 0);
```

## src/user_settings.h
```c
/* SPDX-License-Identifier: GPL-3.0-or-later */
#ifndef USER_SETTINGS_H
#define USER_SETTINGS_H

#include <zephyr/kernel.h>

#define NO_MAIN_DRIVER
#define WOLFMQTT_BROKER
#define WOLFMQTT_BROKER_CUSTOM_NET
#define WOLFMQTT_STATIC_MEMORY
#define WOLFMQTT_V5

#define WOLFMQTT_BROKER_GET_TIME_S() ((unsigned long)(k_uptime_get() / 1000))
#define BROKER_SLEEP_MS(ms) k_msleep(ms)

/* The defaults need about 220 KB of RAM, too much for a plain ESP32 */
#define BROKER_MAX_CLIENTS 10
#define BROKER_MAX_SUBS 32
#define BROKER_RX_BUF_SZ 1024
#define BROKER_TX_BUF_SZ 1024
#define BROKER_MAX_RETAINED 8
#define BROKER_MAX_PAYLOAD_LEN 256
#define BROKER_MAX_CLIENT_ID_LEN 32
#define BROKER_MAX_USERNAME_LEN 32
#define BROKER_MAX_PASSWORD_LEN 32
#define BROKER_MAX_FILTER_LEN 64
#define BROKER_MAX_TOPIC_LEN 64
#define BROKER_MAX_WILL_PAYLOAD_LEN 128
#define BROKER_MAX_STATIC_OFFLINE_MSGS_PER_SUB 4
#define BROKER_MAX_STATIC_OFFLINE_DATA_LEN 128

#endif
```

## src/wifi.c
```c
/* SPDX-License-Identifier: GPL-3.0-or-later */
#include <string.h>
#include <zephyr/kernel.h>
#include <zephyr/net/net_if.h>
#include <zephyr/net/net_ip.h>
#include <zephyr/net/net_mgmt.h>
#include <zephyr/net/wifi_mgmt.h>
#include <zephyr/sys/printk.h>

#include "wifi.h"

#define ADDR_WAIT_SEC 30

static int wifi_request(struct net_if *iface)
{
	struct wifi_connect_req_params params = {
		.ssid = (const uint8_t *)CONFIG_APP_WIFI_SSID,
		.ssid_length = strlen(CONFIG_APP_WIFI_SSID),
		.psk = (const uint8_t *)CONFIG_APP_WIFI_PSK,
		.psk_length = strlen(CONFIG_APP_WIFI_PSK),
		.security = strlen(CONFIG_APP_WIFI_PSK) > 0 ? WIFI_SECURITY_TYPE_PSK
							    : WIFI_SECURITY_TYPE_NONE,
		.channel = WIFI_CHANNEL_ANY,
		.band = WIFI_FREQ_BAND_2_4_GHZ,
		.timeout = SYS_FOREVER_MS,
	};

	return net_mgmt(NET_REQUEST_WIFI_CONNECT, iface, &params, sizeof(params));
}

int wifi_connect(void)
{
	struct net_if *iface = net_if_get_wifi_sta();
	char ip[NET_IPV4_ADDR_LEN];

	if (iface == NULL) {
		printk("no Wi-Fi interface\n");
		return -ENODEV;
	}
	if (strlen(CONFIG_APP_WIFI_SSID) == 0) {
		printk("no Wi-Fi name, see wifi.local.conf.example\n");
		return -EINVAL;
	}

	while (true) {
		printk("connecting to Wi-Fi network %s\n", CONFIG_APP_WIFI_SSID);

		int rc = wifi_request(iface);

		if (rc != 0) {
			printk("Wi-Fi request failed: %d\n", rc);
		}

		for (int i = 0; i < ADDR_WAIT_SEC; i++) {
			struct net_in_addr *addr =
				net_if_ipv4_get_global_addr(iface, NET_ADDR_PREFERRED);

			if (addr != NULL) {
				net_addr_ntop(NET_AF_INET, addr, ip, sizeof(ip));
				printk("board address: %s\n", ip);
				return 0;
			}
			k_sleep(K_SECONDS(1));
		}
		printk("no address yet, trying again\n");
	}
}
```

## src/wifi.h
```c
/* SPDX-License-Identifier: GPL-3.0-or-later */
#ifndef WIFI_H
#define WIFI_H

int wifi_connect(void);

#endif
```
